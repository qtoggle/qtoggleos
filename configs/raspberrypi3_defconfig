## configs/raspberrypi3_defconfig
```kconfig
BR2_arm=y
BR2_cortex_a7=y
BR2_ARM_FPU_NEON_VFPV4=y
BR2_CCACHE=y
BR2_CCACHE_DIR="$(TOPDIR)/.buildroot-ccache-raspberrypi3"
BR2_OPTIMIZE_2=y
BR2_GLOBAL_PATCH_DIR="board/raspberrypi3"
BR2_TOOLCHAIN_EXTERNAL=y
BR2_TOOLCHAIN_EXTERNAL_LINARO_ARM=y
BR2_TARGET_OPTIMIZATION="-pipe"
BR2_ROOTFS_DEVICE_CREATION_DYNAMIC_EUDEV=y
BR2_TARGET_TZ_INFO=y
BR2_ROOTFS_OVERLAY="board/common/overlay board/raspberrypi3/overlay"
BR2_ROOTFS_POST_BUILD_SCRIPT="board/common/postscript.sh"
BR2_LINUX_KERNEL=y
BR2_LINUX_KERNEL_CUSTOM_TARBALL=y
BR2_LINUX_KERNEL_CUSTOM_TARBALL_LOCATION="https://github.com/raspberrypi/linux/archive/6f921e98008589258f97243fb6658d09750f0a2f.tar.gz"
BR2_LINUX_KERNEL_DEFCONFIG="bcm2711"
BR2_LINUX_KERNEL_DTS_SUPPORT=y
BR2_LINUX_KERNEL_INTREE_DTS_NAME="bcm2837-rpi-3-a-plus bcm2710-rpi-3-b bcm2710-rpi-3-b-plus bcm2710-rpi-cm3 bcm2710-rpi-zero-2"
BR2_PACKAGE_BUSYBOX_CONFIG="board/common/busybox.config"
BR2_PACKAGE_QTOGGLESERVER=y
BR2_PACKAGE_QTOGGLESERVER_CMDLINE=y
BR2_PACKAGE_QTOGGLESERVER_DALLASTEMP=y
BR2_PACKAGE_QTOGGLESERVER_EQ3BT=y
BR2_PACKAGE_QTOGGLESERVER_GENERIC_HTTP=y
BR2_PACKAGE_QTOGGLESERVER_MODBUS=y
BR2_PACKAGE_QTOGGLESERVER_MPPSOLAR=y
BR2_PACKAGE_QTOGGLESERVER_PARADOX=y
BR2_PACKAGE_QTOGGLESERVER_PUSHOVER=y
BR2_PACKAGE_QTOGGLESERVER_PYLONTECH=y
BR2_PACKAGE_QTOGGLESERVER_RASPIGPIO=y
BR2_PACKAGE_QTOGGLESERVER_RPIGPIO=y
BR2_PACKAGE_QTOGGLESERVER_THINGSPEAK=y
BR2_PACKAGE_ALSA_UTILS=y
BR2_PACKAGE_ALSA_UTILS_APLAY=y
BR2_PACKAGE_GZIP=y
BR2_PACKAGE_JQ=y
BR2_PACKAGE_E2FSPROGS=y
BR2_PACKAGE_FUSE_OVERLAYFS=y
BR2_PACKAGE_NTFS_3G=y
BR2_PACKAGE_B43_FIRMWARE=y
BR2_PACKAGE_LINUX_FIRMWARE=y
BR2_PACKAGE_LINUX_FIRMWARE_ATHEROS_7010=y
BR2_PACKAGE_LINUX_FIRMWARE_ATHEROS_9170=y
BR2_PACKAGE_LINUX_FIRMWARE_ATHEROS_9271=y
BR2_PACKAGE_LINUX_FIRMWARE_MWIFIEX_USB8797=y
BR2_PACKAGE_LINUX_FIRMWARE_MWIFIEX_USB8897=y
BR2_PACKAGE_LINUX_FIRMWARE_MEDIATEK_MT7601U=y
BR2_PACKAGE_LINUX_FIRMWARE_RALINK_RT61=y
BR2_PACKAGE_LINUX_FIRMWARE_RALINK_RT73=y
BR2_PACKAGE_LINUX_FIRMWARE_RALINK_RT2XX=y
BR2_PACKAGE_LINUX_FIRMWARE_RTL_81XX=y
BR2_PACKAGE_LINUX_FIRMWARE_RTL_87XX=y
BR2_PACKAGE_LINUX_FIRMWARE_RTL_88XX=y
BR2_PACKAGE_RPI_BT_FIRMWARE=y
BR2_PACKAGE_RPI_FIRMWARE=y
BR2_PACKAGE_RPI_FIRMWARE_BOOTCODE_BIN=y
BR2_PACKAGE_RPI_FIRMWARE_VARIANT_PI=y
BR2_PACKAGE_RPI_WIFI_FIRMWARE=y
BR2_PACKAGE_RNG_TOOLS=y
BR2_PACKAGE_RPI_ARMMEM=y
BR2_PACKAGE_RPI_USERLAND=y
BR2_PACKAGE_USB_MODESWITCH_DATA=y
BR2_PACKAGE_PYTHON3_READLINE=y
BR2_PACKAGE_PYTHON_AIOHTTP=y
BR2_PACKAGE_PYTHON_AIOSIGNAL=y
BR2_PACKAGE_PYTHON_ASYNCPG=y
BR2_PACKAGE_PYTHON_BLEAK=y
BR2_PACKAGE_PYTHON_DBUS_FAST=y
BR2_PACKAGE_PYTHON_JINJA2=y
BR2_PACKAGE_PYTHON_JSONPOINTER=y
BR2_PACKAGE_PYTHON_PIP=y
BR2_PACKAGE_PYTHON_PSUTIL=y
BR2_PACKAGE_PYTHON_PYCRYPTODOMEX=y
BR2_PACKAGE_PYTHON_PYHOCON=y
BR2_PACKAGE_PYTHON_PYJWT=y
BR2_PACKAGE_PYTHON_PYMODBUS=y
BR2_PACKAGE_PYTHON_PYTZ=y
BR2_PACKAGE_PYTHON_QUI_SERVER=y
BR2_PACKAGE_PYTHON_REDIS=y
BR2_PACKAGE_PYTHON_SERIAL_ASYNCIO=y
BR2_PACKAGE_PYTHON_TORNADO=y
BR2_PACKAGE_CA_CERTIFICATES=y
BR2_PACKAGE_LIBSSH2=y
BR2_PACKAGE_POSTGRESQL=y
BR2_PACKAGE_REDIS=y
BR2_PACKAGE_LIBFUSE=y
BR2_PACKAGE_GMP=y
BR2_PACKAGE_LIBCAP=y
BR2_PACKAGE_SEMVER_SORT=y
BR2_PACKAGE_AUTOSSH=y
BR2_PACKAGE_BLUEZ5_UTILS=y
BR2_PACKAGE_BLUEZ5_UTILS_CLIENT=y
BR2_PACKAGE_BLUEZ5_UTILS_TOOLS=y
BR2_PACKAGE_CHRONY=y
BR2_PACKAGE_CLOUDFLARED=y
BR2_PACKAGE_CRDA=y
BR2_PACKAGE_DEHYDRATED=y
BR2_PACKAGE_DHCP=y
BR2_PACKAGE_DHCP_CLIENT=y
BR2_PACKAGE_DNSMASQ=y
BR2_PACKAGE_HOSTAPD=y
# BR2_PACKAGE_IFUPDOWN_SCRIPTS is not set
BR2_PACKAGE_IW=y
BR2_PACKAGE_NET_TOOLS=y
BR2_PACKAGE_NETCAT=y
BR2_PACKAGE_NTP=y
BR2_PACKAGE_NTP_SNTP=y
# BR2_PACKAGE_NTP_NTPD is not set
BR2_PACKAGE_OPENSSH=y
BR2_PACKAGE_PPPD=y
BR2_PACKAGE_RPORT=y
BR2_PACKAGE_SOCAT=y
BR2_PACKAGE_WIRELESS_TOOLS=y
BR2_PACKAGE_WPA_SUPPLICANT=y
BR2_PACKAGE_WPA_SUPPLICANT_AUTOSCAN=y
BR2_PACKAGE_WPA_SUPPLICANT_EAP=y
BR2_PACKAGE_WPA_SUPPLICANT_WPS=y
BR2_PACKAGE_WPA_SUPPLICANT_CLI=y
BR2_PACKAGE_LOGROTATE=y
BR2_PACKAGE_DOCKER_CLI=y
BR2_PACKAGE_DOCKER_COMPOSE=y
BR2_PACKAGE_DOCKER_ENGINE=y
BR2_PACKAGE_HTOP=y
BR2_PACKAGE_TAR=y
BR2_PACKAGE_UTIL_LINUX_BINARIES=y
BR2_PACKAGE_UTIL_LINUX_LOSETUP=y
BR2_PACKAGE_UTIL_LINUX_PARTX=y
BR2_PACKAGE_NANO=y
```

## package/ch347-vcp/Config.in
```kconfig
config BR2_PACKAGE_CH347_VCP
	bool "ch347-vcp"
	depends on BR2_LINUX_KERNEL

comment "CH347-VCP needs a Linux kernel to be built"
	depends on !BR2_LINUX_KERNEL
```

## package/python-aiomqtt/Config.in
```kconfig
config BR2_PACKAGE_PYTHON_AIOMQTT
	bool "python-aiomqtt"
	depends on BR2_PACKAGE_PYTHON3
	select BR2_PACKAGE_PYTHON_PAHO_MQTT # runtime
	help
	  The idiomatic asyncio MQTT client, wrapped around paho-mqtt.

	  https://github.com/sbtinstruments/aiomqtt
```

## package/python-argparse/Config.in
```kconfig
config BR2_PACKAGE_PYTHON_ARGPARSE
	bool "python-argparse"
	depends on BR2_PACKAGE_PYTHON3
```

## package/python-construct/Config.in
```kconfig
config BR2_PACKAGE_PYTHON_CONSTRUCT
	bool "python-construct"
	depends on BR2_PACKAGE_PYTHON3
```

## package/python-paradox-alarm-interface/Config.in
```kconfig
config BR2_PACKAGE_PYTHON_PARADOX_ALARM_INTERFACE
	bool "python-paradox-alarm-interface"
	depends on BR2_PACKAGE_PYTHON3
    select BR2_PACKAGE_PYTHON_ARGPARSE
    select BR2_PACKAGE_PYTHON_CONSTRUCT
    select BR2_PACKAGE_PYTHON_SLUGIFY
```

## package/python-pylontech/Config.in
```kconfig
config BR2_PACKAGE_PYTHON_PYLONTECH
	bool "python-pylontech"
	depends on BR2_PACKAGE_PYTHON3
    select BR2_PACKAGE_PYTHON_CONSTRUCT
```

## package/python-qui-server/Config.in
```kconfig
config BR2_PACKAGE_PYTHON_QUI_SERVER
	bool "python-qui-server"
	depends on BR2_PACKAGE_PYTHON3
	help
	  Server package for QUI.

	  https://github.com/qtoggle/qui
```

## package/python-slugify/Config.in
```kconfig
config BR2_PACKAGE_PYTHON_SLUGIFY
	bool "python-slugify"
	depends on BR2_PACKAGE_PYTHON3
	select BR2_PACKAGE_PYTHON_TEXT_UNIDECODE
```

## package/python-text-unidecode/Config.in
```kconfig
config BR2_PACKAGE_PYTHON_TEXT_UNIDECODE
	bool "python-text-unidecode"
	depends on BR2_PACKAGE_PYTHON3
```

## package/qtoggleserver-cmdline/Config.in
```kconfig
config BR2_PACKAGE_QTOGGLESERVER_CMDLINE
	bool "qtoggleserver-cmdline"
	depends on BR2_PACKAGE_PYTHON3 && BR2_PACKAGE_QTOGGLESERVER
```

## package/qtoggleserver-dallastemp/Config.in
```kconfig
config BR2_PACKAGE_QTOGGLESERVER_DALLASTEMP
	bool "qtoggleserver-dallastemp"
	depends on BR2_PACKAGE_PYTHON3 && BR2_PACKAGE_QTOGGLESERVER
```

## package/qtoggleserver-eq3bt/Config.in
```kconfig
config BR2_PACKAGE_QTOGGLESERVER_EQ3BT
	bool "qtoggleserver-eq3bt"
	depends on BR2_PACKAGE_PYTHON3 && BR2_PACKAGE_QTOGGLESERVER
```

## package/qtoggleserver-generic-http/Config.in
```kconfig
config BR2_PACKAGE_QTOGGLESERVER_GENERIC_HTTP
	bool "qtoggleserver-generic-http"
	depends on BR2_PACKAGE_PYTHON3 && BR2_PACKAGE_QTOGGLESERVER
```

## package/qtoggleserver-modbus/Config.in
```kconfig
config BR2_PACKAGE_QTOGGLESERVER_MODBUS
	bool "qtoggleserver-modbus"
	depends on BR2_PACKAGE_PYTHON3 && BR2_PACKAGE_QTOGGLESERVER
	select BR2_PACKAGE_PYTHON_MODBUS
```

## package/qtoggleserver-mppsolar/Config.in
```kconfig
config BR2_PACKAGE_QTOGGLESERVER_MPPSOLAR
	bool "qtoggleserver-mppsolar"
	depends on BR2_PACKAGE_PYTHON3 && BR2_PACKAGE_QTOGGLESERVER
```

## package/qtoggleserver-mqtt/Config.in
```kconfig
config BR2_PACKAGE_QTOGGLESERVER_MQTT
	bool "qtoggleserver-mqtt"
	depends on BR2_PACKAGE_PYTHON3 && BR2_PACKAGE_QTOGGLESERVER
	select BR2_PACKAGE_PYTHON_MQTT
```

## package/qtoggleserver-paradox/Config.in
```kconfig
config BR2_PACKAGE_QTOGGLESERVER_PARADOX
	bool "qtoggleserver-paradox"
	depends on BR2_PACKAGE_PYTHON3 && BR2_PACKAGE_QTOGGLESERVER
	select BR2_PACKAGE_PYTHON_PARADOX_ALARM_INTERFACE
```

## package/qtoggleserver-pushover/Config.in
```kconfig
config BR2_PACKAGE_QTOGGLESERVER_PUSHOVER
	bool "qtoggleserver-pushover"
	depends on BR2_PACKAGE_PYTHON3 && BR2_PACKAGE_QTOGGLESERVER
```

## package/qtoggleserver-pylontech/Config.in
```kconfig
config BR2_PACKAGE_QTOGGLESERVER_PYLONTECH
	bool "qtoggleserver-pylontech"
	depends on BR2_PACKAGE_PYTHON3 && BR2_PACKAGE_QTOGGLESERVER
	select BR2_PACKAGE_PYTHON_PYLONTECH
```

## package/qtoggleserver-raspigpio/Config.in
```kconfig
config BR2_PACKAGE_QTOGGLESERVER_RASPIGPIO
	bool "qtoggleserver-raspigpio"
	depends on BR2_PACKAGE_PYTHON3 && BR2_PACKAGE_QTOGGLESERVER
	select BR2_PACKAGE_RASPI_GPIO
```

## package/qtoggleserver-rpigpio/Config.in
```kconfig
config BR2_PACKAGE_QTOGGLESERVER_RPIGPIO
	bool "qtoggleserver-rpigpio"
	depends on BR2_PACKAGE_PYTHON3 && BR2_PACKAGE_QTOGGLESERVER
	select BR2_PACKAGE_PYTHON_RPI_GPIO
```

## package/qtoggleserver-thingspeak/Config.in
```kconfig
config BR2_PACKAGE_QTOGGLESERVER_THINGSPEAK
	bool "qtoggleserver-thingspeak"
	depends on BR2_PACKAGE_PYTHON3 && BR2_PACKAGE_QTOGGLESERVER
```

## package/qtoggleserver-zigbee2mqtt/Config.in
```kconfig
config BR2_PACKAGE_QTOGGLESERVER_ZIGBEE2MQTT
	bool "qtoggleserver-zigbee2mqtt"
	depends on BR2_PACKAGE_PYTHON3 && BR2_PACKAGE_QTOGGLESERVER
	select BR2_PACKAGE_PYTHON_ZIGBEE2MQTT
```
